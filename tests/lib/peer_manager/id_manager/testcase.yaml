## tests/lib/peer_manager/id_manager/testcase.yaml
```yaml
tests:
  lib.peer_manager.id_manager:
    platform_allow: native_sim
    tags: unittest
```

## tests/lib/peer_manager/security_manager/testcase.yaml
```yaml
tests:
  lib.peer_manager.security_manager:
    platform_allow: native_sim
    tags: unittest
```
